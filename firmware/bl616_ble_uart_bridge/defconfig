## verification/firmware/bl616_ble_diagnostic/defconfig
```kconfig
CONFIG_FREERTOS=y
CONFIG_BFLB_LOG=n
CONFIG_RF=y
CONFIG_BLUETOOTH=y
CONFIG_BTBLECONTROLLER_LIB=ble1m0s1bredr0
CONFIG_BT_STACK_CLI=n
CONFIG_BT_SETTINGS=n
CONFIG_BT_OAD_SERVER=n
CONFIG_BFLB_MTD=n
CONFIG_PARTITION=n
CONFIG_LITTLEFS=n
CONFIG_SHELL=y
CONFIG_CHERRYUSB=y
CONFIG_CHERRYUSB_OSAL=freertos
CONFIG_CHERRYUSB_DEVICE=y
CONFIG_CHERRYUSB_DEVICE_CDC_ACM=y
CONFIG_BSP_CONSOLE_USB_CDC=y
```
